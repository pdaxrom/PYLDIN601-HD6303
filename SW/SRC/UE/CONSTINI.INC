(*)segment (*) procedure ConstInit;
begin
Cchar := #31;
 Tokens[CmdType(000),1]:= ' '      ; Tokens[CmdType(000),2]:= ''      ; Tokens[CmdType(000),3]:= '' ;
 Tokens[CmdType(001),1]:= 'LEFT'   ; Tokens[CmdType(001),2]:= ''      ; Tokens[CmdType(001),3]:= '' ;
 Tokens[CmdType(002),1]:= 'RIGHT'  ; Tokens[CmdType(002),2]:= ''      ; Tokens[CmdType(002),3]:= '' ;
 Tokens[CmdType(003),1]:= 'LEFT'   ; Tokens[CmdType(003),2]:= 'WORD'  ; Tokens[CmdType(003),3]:= '' ;
 Tokens[CmdType(004),1]:= 'RIGHT'  ; Tokens[CmdType(004),2]:= 'WORD'  ; Tokens[CmdType(004),3]:= '' ;
 Tokens[CmdType(005),1]:= 'UP'     ; Tokens[CmdType(005),2]:= ''      ; Tokens[CmdType(005),3]:= '' ;
 Tokens[CmdType(006),1]:= 'DOWN'   ; Tokens[CmdType(006),2]:= ''      ; Tokens[CmdType(006),3]:= '' ;
 Tokens[CmdType(007),1]:= 'SCROLL' ; Tokens[CmdType(007),2]:= 'UP'    ; Tokens[CmdType(007),3]:= '' ;
 Tokens[CmdType(008),1]:= 'SCROLL' ; Tokens[CmdType(008),2]:= 'DOWN'  ; Tokens[CmdType(008),3]:= '' ;
 Tokens[CmdType(009),1]:= 'PAGE'   ; Tokens[CmdType(009),2]:= 'DOWN'  ; Tokens[CmdType(009),3]:= '' ;
 Tokens[CmdType(010),1]:= 'PAGE'   ; Tokens[CmdType(010),2]:= 'UP'    ; Tokens[CmdType(010),3]:= '' ;
 Tokens[CmdType(011),1]:= 'TOP'    ; Tokens[CmdType(011),2]:= 'FILE'  ; Tokens[CmdType(011),3]:= '' ;
 Tokens[CmdType(012),1]:= 'BOTTOM' ; Tokens[CmdType(012),2]:= 'FILE'  ; Tokens[CmdType(012),3]:= '' ;
 Tokens[CmdType(013),1]:= 'BEGIN'  ; Tokens[CmdType(013),2]:= 'LINE'  ; Tokens[CmdType(013),3]:= '' ;
 Tokens[CmdType(014),1]:= 'END'    ; Tokens[CmdType(014),2]:= 'LINE'  ; Tokens[CmdType(014),3]:= '' ;
 Tokens[CmdType(015),1]:= 'TOP'    ; Tokens[CmdType(015),2]:= 'EDGE'  ; Tokens[CmdType(015),3]:= '' ;
 Tokens[CmdType(016),1]:= 'BOTTOM' ; Tokens[CmdType(016),2]:= 'EDGE'  ; Tokens[CmdType(016),3]:= '' ;
 Tokens[CmdType(017),1]:= 'SPLIT'  ; Tokens[CmdType(017),2]:= ''      ; Tokens[CmdType(017),3]:= '' ;
 Tokens[CmdType(018),1]:= 'JOIN'   ; Tokens[CmdType(018),2]:= ''      ; Tokens[CmdType(018),3]:= '' ;
 Tokens[CmdType(019),1]:= 'GO'     ; Tokens[CmdType(019),2]:= 'LINE'  ; Tokens[CmdType(019),3]:= '' ;
 Tokens[CmdType(020),1]:= 'GO'     ; Tokens[CmdType(020),2]:= 'COLUMN'; Tokens[CmdType(020),3]:= '' ;
 Tokens[CmdType(021),1]:= 'TAB'    ; Tokens[CmdType(021),2]:= 'BACK'  ; Tokens[CmdType(021),3]:= '' ;
 Tokens[CmdType(022),1]:= 'LAST'   ; Tokens[CmdType(022),2]:= 'CURSOR'; Tokens[CmdType(022),3]:= '' ;
 Tokens[CmdType(023),1]:= 'UNDO'   ; Tokens[CmdType(023),2]:= ''      ; Tokens[CmdType(023),3]:= '' ;
 Tokens[CmdType(024),1]:= 'RE'     ; Tokens[CmdType(024),2]:= 'STORE' ; Tokens[CmdType(024),3]:= '' ;
 Tokens[CmdType(025),1]:= 'TAB'    ; Tokens[CmdType(025),2]:= ''      ; Tokens[CmdType(025),3]:= '' ;
 Tokens[CmdType(026),1]:= 'CTRL'   ; Tokens[CmdType(026),2]:= 'CHAR'  ; Tokens[CmdType(026),3]:= '' ;
 CtrlTok:= #26;
 Tokens[CmdType(027),1]:= 'NEW'    ; Tokens[CmdType(027),2]:= 'LINE'  ; Tokens[CmdType(027),3]:= '' ;
 Tokens[CmdType(028),1]:= 'INS'    ; Tokens[CmdType(028),2]:= 'LINE'  ; Tokens[CmdType(028),3]:= '' ;
 Tokens[CmdType(029),1]:= 'DELETE' ; Tokens[CmdType(029),2]:= 'CHAR'  ; Tokens[CmdType(029),3]:= '' ;
 Tokens[CmdType(030),1]:= 'RUBOUT' ; Tokens[CmdType(030),2]:= ''      ; Tokens[CmdType(030),3]:= '' ;
 Tokens[CmdType(031),1]:= 'DELETE' ; Tokens[CmdType(031),2]:= 'WORD'  ; Tokens[CmdType(031),3]:= '' ;
 Tokens[CmdType(032),1]:= 'DELETE' ; Tokens[CmdType(032),2]:= 'END'   ; Tokens[CmdType(032),3]:= 'LINE';
 Tokens[CmdType(033),1]:= 'DELETE' ; Tokens[CmdType(033),2]:= 'LINE'  ; Tokens[CmdType(033),3]:= '' ;
 Tokens[CmdType(034),1]:= 'CENTER' ; Tokens[CmdType(034),2]:= 'LINE'  ; Tokens[CmdType(034),3]:= '' ;
 Tokens[CmdType(035),1]:= 'FIND'   ; Tokens[CmdType(035),2]:= 'AGAIN' ; Tokens[CmdType(035),3]:= '' ;
 Tokens[CmdType(036),1]:= 'CHANGE' ; Tokens[CmdType(036),2]:= ''      ; Tokens[CmdType(036),3]:= '' ;
 Tokens[CmdType(037),1]:= ' '      ; Tokens[CmdType(037),2]:= ''      ; Tokens[CmdType(037),3]:= '' ;
 Tokens[CmdType(038),1]:= 'FIND'   ; Tokens[CmdType(038),2]:= ''      ; Tokens[CmdType(038),3]:= '' ;
 Tokens[CmdType(039),1]:= ' '      ; Tokens[CmdType(039),2]:= ''      ; Tokens[CmdType(039),3]:= '' ;
 Tokens[CmdType(040),1]:= 'SAVE'   ; Tokens[CmdType(040),2]:= 'FILE'  ; Tokens[CmdType(040),3]:= '' ;
 Tokens[CmdType(041),1]:= 'NAME'   ; Tokens[CmdType(041),2]:= ''      ; Tokens[CmdType(041),3]:= '' ;
 Tokens[CmdType(042),1]:= 'QUIT'   ; Tokens[CmdType(042),2]:= ''      ; Tokens[CmdType(042),3]:= '' ;
 Tokens[CmdType(043),1]:= 'READ'   ; Tokens[CmdType(043),2]:= 'BLOCK' ; Tokens[CmdType(043),3]:= '' ;
 Tokens[CmdType(044),1]:= 'SAVE'   ; Tokens[CmdType(044),2]:= ''      ; Tokens[CmdType(044),3]:= '' ;
 Tokens[CmdType(045),1]:= 'WRITE'  ; Tokens[CmdType(045),2]:= 'BLOCK' ; Tokens[CmdType(045),3]:= '' ;
 Tokens[CmdType(046),1]:= 'EXIT'   ; Tokens[CmdType(046),2]:= ''      ; Tokens[CmdType(046),3]:= '' ;
 Tokens[CmdType(047),1]:= 'ADD'    ; Tokens[CmdType(047),2]:= 'WINDOW'; Tokens[CmdType(047),3]:= '' ;
 Tokens[CmdType(048),1]:= 'SIZE'   ; Tokens[CmdType(048),2]:= 'WINDOW'; Tokens[CmdType(048),3]:= '' ;
 Tokens[CmdType(049),1]:= ' '      ; Tokens[CmdType(049),2]:= ''      ; Tokens[CmdType(049),3]:= '' ;
 Tokens[CmdType(050),1]:= 'NEXT'   ; Tokens[CmdType(050),2]:= 'WINDOW'; Tokens[CmdType(050),3]:= '' ;
 Tokens[CmdType(051),1]:= ' '      ; Tokens[CmdType(051),2]:= ''      ; Tokens[CmdType(051),3]:= '' ;
 Tokens[CmdType(052),1]:= ' '      ; Tokens[CmdType(052),2]:= ''      ; Tokens[CmdType(052),3]:= '' ;
 Tokens[CmdType(053),1]:= 'MARK'   ; Tokens[CmdType(053),2]:= 'BLOCK' ; Tokens[CmdType(053),3]:= 'BEGIN';
 Tokens[CmdType(054),1]:= 'MARK'   ; Tokens[CmdType(054),2]:= 'BLOCK' ; Tokens[CmdType(054),3]:= 'END';
 Tokens[CmdType(055),1]:= 'BLOCK'  ; Tokens[CmdType(055),2]:= 'TOP'   ; Tokens[CmdType(055),3]:= '' ;
 Tokens[CmdType(056),1]:= 'BLOCK'  ; Tokens[CmdType(056),2]:= 'BOTTOM'; Tokens[CmdType(056),3]:= '' ;
 Tokens[CmdType(057),1]:= 'COPY'   ; Tokens[CmdType(057),2]:= 'BLOCK' ; Tokens[CmdType(057),3]:= '' ;
 Tokens[CmdType(058),1]:= 'MOVE'   ; Tokens[CmdType(058),2]:= 'BLOCK' ; Tokens[CmdType(058),3]:= '' ;
 Tokens[CmdType(059),1]:= 'DELETE' ; Tokens[CmdType(059),2]:= 'BLOCK' ; Tokens[CmdType(059),3]:= '' ;
 Tokens[CmdType(060),1]:= 'UNMARK' ; Tokens[CmdType(060),2]:= ''      ; Tokens[CmdType(060),3]:= '' ;
 Tokens[CmdType(061),1]:= 'MARK'   ; Tokens[CmdType(061),2]:= 'WORD'  ; Tokens[CmdType(061),3]:= '' ;
 Tokens[CmdType(062),1]:= 'SHOW'   ; Tokens[CmdType(062),2]:= 'MARKS' ; Tokens[CmdType(062),3]:= '' ;
 Tokens[CmdType(063),1]:= 'SET'    ; Tokens[CmdType(063),2]:= 'MARK'  ; Tokens[CmdType(063),3]:= '0';
 Tokens[CmdType(064),1]:= 'SET'    ; Tokens[CmdType(064),2]:= 'MARK'  ; Tokens[CmdType(064),3]:= '1';
 Tokens[CmdType(065),1]:= 'SET'    ; Tokens[CmdType(065),2]:= 'MARK'  ; Tokens[CmdType(065),3]:= '2';
 Tokens[CmdType(066),1]:= 'SET'    ; Tokens[CmdType(066),2]:= 'MARK'  ; Tokens[CmdType(066),3]:= '3';
 Tokens[CmdType(067),1]:= 'SET'    ; Tokens[CmdType(067),2]:= 'MARK'  ; Tokens[CmdType(067),3]:= '4';
 Tokens[CmdType(068),1]:= 'SET'    ; Tokens[CmdType(068),2]:= 'MARK'  ; Tokens[CmdType(068),3]:= '5';
 Tokens[CmdType(069),1]:= 'SET'    ; Tokens[CmdType(069),2]:= 'MARK'  ; Tokens[CmdType(069),3]:= '6';
 Tokens[CmdType(070),1]:= 'SET'    ; Tokens[CmdType(070),2]:= 'MARK'  ; Tokens[CmdType(070),3]:= '7';
 Tokens[CmdType(071),1]:= 'SET'    ; Tokens[CmdType(071),2]:= 'MARK'  ; Tokens[CmdType(071),3]:= '8';
 Tokens[CmdType(072),1]:= 'SET'    ; Tokens[CmdType(072),2]:= 'MARK'  ; Tokens[CmdType(072),3]:= '9';
 Tokens[CmdType(073),1]:= 'GO'     ; Tokens[CmdType(073),2]:= 'MARK'  ; Tokens[CmdType(073),3]:= '0';
 Tokens[CmdType(074),1]:= 'GO'     ; Tokens[CmdType(074),2]:= 'MARK'  ; Tokens[CmdType(074),3]:= '1';
 Tokens[CmdType(075),1]:= 'GO'     ; Tokens[CmdType(075),2]:= 'MARK'  ; Tokens[CmdType(075),3]:= '2';
 Tokens[CmdType(076),1]:= 'GO'     ; Tokens[CmdType(076),2]:= 'MARK'  ; Tokens[CmdType(076),3]:= '3';
 Tokens[CmdType(077),1]:= 'GO'     ; Tokens[CmdType(077),2]:= 'MARK'  ; Tokens[CmdType(077),3]:= '4';
 Tokens[CmdType(078),1]:= 'GO'     ; Tokens[CmdType(078),2]:= 'MARK'  ; Tokens[CmdType(078),3]:= '5';
 Tokens[CmdType(079),1]:= 'GO'     ; Tokens[CmdType(079),2]:= 'MARK'  ; Tokens[CmdType(079),3]:= '6';
 Tokens[CmdType(080),1]:= 'GO'     ; Tokens[CmdType(080),2]:= 'MARK'  ; Tokens[CmdType(080),3]:= '7';
 Tokens[CmdType(081),1]:= 'GO'     ; Tokens[CmdType(081),2]:= 'MARK'  ; Tokens[CmdType(081),3]:= '8';
 Tokens[CmdType(082),1]:= 'GO'     ; Tokens[CmdType(082),2]:= 'MARK'  ; Tokens[CmdType(082),3]:= '9';
 Tokens[CmdType(083),1]:= 'PRINT'  ; Tokens[CmdType(083),2]:= 'BLOCK' ; Tokens[CmdType(083),3]:= '' ;
 Tokens[CmdType(084),1]:= 'PRINT'  ; Tokens[CmdType(084),2]:= 'FILE'  ; Tokens[CmdType(084),3]:= '' ;
 Tokens[CmdType(085),1]:= 'REFLOW' ; Tokens[CmdType(085),2]:= ''      ; Tokens[CmdType(085),3]:= '' ;
 Tokens[CmdType(086),1]:= 'JUST'   ; Tokens[CmdType(086),2]:= 'IFY'   ; Tokens[CmdType(086),3]:= '' ;
 Tokens[CmdType(087),1]:= ' '      ; Tokens[CmdType(087),2]:= ''      ; Tokens[CmdType(087),3]:= '' ;
 Tokens[CmdType(088),1]:= ' '      ; Tokens[CmdType(088),2]:= ''      ; Tokens[CmdType(088),3]:= '' ;
 Tokens[CmdType(089),1]:= ' '      ; Tokens[CmdType(089),2]:= ''      ; Tokens[CmdType(089),3]:= '' ;
 Tokens[CmdType(090),1]:= ' '      ; Tokens[CmdType(090),2]:= ''      ; Tokens[CmdType(090),3]:= '' ;
 Tokens[CmdType(091),1]:= ' '      ; Tokens[CmdType(091),2]:= ''      ; Tokens[CmdType(091),3]:= '' ;
 Tokens[CmdType(092),1]:= ' '      ; Tokens[CmdType(092),2]:= ''      ; Tokens[CmdType(092),3]:= '' ;
 Tokens[CmdType(093),1]:= ' '      ; Tokens[CmdType(093),2]:= ''      ; Tokens[CmdType(093),3]:= '' ;
 Tokens[CmdType(094),1]:= ' '      ; Tokens[CmdType(094),2]:= ''      ; Tokens[CmdType(094),3]:= '' ;
 Tokens[CmdType(095),1]:= ' '      ; Tokens[CmdType(095),2]:= ''      ; Tokens[CmdType(095),3]:= '' ;
 Tokens[CmdType(096),1]:= ' '      ; Tokens[CmdType(096),2]:= ''      ; Tokens[CmdType(096),3]:= '' ;
 Tokens[CmdType(097),1]:= ' '      ; Tokens[CmdType(097),2]:= ''      ; Tokens[CmdType(097),3]:= '' ;
 Tokens[CmdType(098),1]:= ' '      ; Tokens[CmdType(098),2]:= ''      ; Tokens[CmdType(098),3]:= '' ;
 Tokens[CmdType(099),1]:= ' '      ; Tokens[CmdType(099),2]:= ''      ; Tokens[CmdType(099),3]:= '' ;
 Tokens[CmdType(100),1]:= 'TOGGLE' ; Tokens[CmdType(100),2]:= 'DEBUG' ; Tokens[CmdType(100),3]:= '' ;
 Tokens[CmdType(101),1]:= ' '      ; Tokens[CmdType(101),2]:= ''      ; Tokens[CmdType(101),3]:= '' ;
 Tokens[CmdType(102),1]:= ' '      ; Tokens[CmdType(102),2]:= ''      ; Tokens[CmdType(102),3]:= '' ;
 Tokens[CmdType(103),1]:= ' '      ; Tokens[CmdType(103),2]:= ''      ; Tokens[CmdType(103),3]:= '' ;
 Tokens[CmdType(104),1]:= ' '      ; Tokens[CmdType(104),2]:= ''      ; Tokens[CmdType(104),3]:= '' ;
 Tokens[CmdType(105),1]:= 'INFO'   ; Tokens[CmdType(105),2]:= ''      ; Tokens[CmdType(105),3]:= '' ;
 Tokens[CmdType(106),1]:= 'MEM'    ; Tokens[CmdType(106),2]:= ''      ; Tokens[CmdType(106),3]:= '' ;
 Tokens[CmdType(107),1]:= 'TOGGLE' ; Tokens[CmdType(107),2]:= 'INS'   ; Tokens[CmdType(107),3]:= '' ;
 Tokens[CmdType(108),1]:= 'TOGGLE' ; Tokens[CmdType(108),2]:= 'INDENT'; Tokens[CmdType(108),3]:= '' ;
 Tokens[CmdType(109),1]:= ' '      ; Tokens[CmdType(109),2]:= ''      ; Tokens[CmdType(109),3]:= '' ;
 Tokens[CmdType(110),1]:= ' '      ; Tokens[CmdType(110),2]:= ''      ; Tokens[CmdType(110),3]:= '' ;
 Tokens[CmdType(111),1]:= ' '      ; Tokens[CmdType(111),2]:= ''      ; Tokens[CmdType(111),3]:= '' ;
 Tokens[CmdType(112),1]:= ' '      ; Tokens[CmdType(112),2]:= ''      ; Tokens[CmdType(112),3]:= '' ;
 Tokens[CmdType(113),1]:= ' '      ; Tokens[CmdType(113),2]:= ''      ; Tokens[CmdType(113),3]:= '' ;
 Tokens[CmdType(114),1]:= ' '      ; Tokens[CmdType(114),2]:= ''      ; Tokens[CmdType(114),3]:= '' ;
 Tokens[CmdType(115),1]:= ' '      ; Tokens[CmdType(115),2]:= ''      ; Tokens[CmdType(115),3]:= '' ;
 Tokens[CmdType(116),1]:= ' '      ; Tokens[CmdType(116),2]:= ''      ; Tokens[CmdType(116),3]:= '' ;
 Tokens[CmdType(117),1]:= ' '      ; Tokens[CmdType(117),2]:= ''      ; Tokens[CmdType(117),3]:= '' ;
 Tokens[CmdType(118),1]:= ' '      ; Tokens[CmdType(118),2]:= ''      ; Tokens[CmdType(118),3]:= '' ;
 Tokens[CmdType(119),1]:= ' '      ; Tokens[CmdType(119),2]:= ''      ; Tokens[CmdType(119),3]:= '' ;
 Tokens[CmdType(120),1]:= ' '      ; Tokens[CmdType(120),2]:= ''      ; Tokens[CmdType(120),3]:= '' ;
 Tokens[CmdType(121),1]:= ' '      ; Tokens[CmdType(121),2]:= ''      ; Tokens[CmdType(121),3]:= '' ;
 Tokens[CmdType(122),1]:= ' '      ; Tokens[CmdType(122),2]:= ''      ; Tokens[CmdType(122),3]:= '' ;
 Tokens[CmdType(123),1]:= ' '      ; Tokens[CmdType(123),2]:= ''      ; Tokens[CmdType(123),3]:= '' ;
 Tokens[CmdType(124),1]:= ' '      ; Tokens[CmdType(124),2]:= ''      ; Tokens[CmdType(124),3]:= '' ;
 Tokens[CmdType(125),1]:= ' '      ; Tokens[CmdType(125),2]:= ''      ; Tokens[CmdType(125),3]:= '' ;
 Tokens[CmdType(126),1]:= ' '      ; Tokens[CmdType(126),2]:= ''      ; Tokens[CmdType(126),3]:= '' ;
 Tokens[CmdType(127),1]:= ' '      ; Tokens[CmdType(127),2]:= ''      ; Tokens[CmdType(127),3]:= '' ;
 Tokens[CmdType(128),1]:= 'LOG'    ; Tokens[CmdType(128),2]:= 'DRIVE' ; Tokens[CmdType(128),3]:= '' ;
 Tokens[CmdType(129),1]:= ' '      ; Tokens[CmdType(129),2]:= ''      ; Tokens[CmdType(129),3]:= '' ;
 Tokens[CmdType(130),1]:= ' '      ; Tokens[CmdType(130),2]:= ''      ; Tokens[CmdType(130),3]:= '' ;
 Tokens[CmdType(131),1]:= ' '      ; Tokens[CmdType(131),2]:= ''      ; Tokens[CmdType(131),3]:= '' ;
 Tokens[CmdType(132),1]:= ' '      ; Tokens[CmdType(132),2]:= ''      ; Tokens[CmdType(132),3]:= '' ;
 Tokens[CmdType(133),1]:= ' '      ; Tokens[CmdType(133),2]:= ''      ; Tokens[CmdType(133),3]:= '' ;
 Tokens[CmdType(134),1]:= 'SET'    ; Tokens[CmdType(134),2]:= 'LIMIT' ; Tokens[CmdType(134),3]:= '' ;
 Tokens[CmdType(135),1]:= ' '      ; Tokens[CmdType(135),2]:= ''      ; Tokens[CmdType(135),3]:= '' ;
 Tokens[CmdType(136),1]:= 'SET'    ; Tokens[CmdType(136),2]:= 'EXT'   ; Tokens[CmdType(136),3]:= '' ;
 Tokens[CmdType(137),1]:= ' '      ; Tokens[CmdType(137),2]:= ''      ; Tokens[CmdType(137),3]:= '' ;
 Tokens[CmdType(138),1]:= ' '      ; Tokens[CmdType(138),2]:= ''      ; Tokens[CmdType(138),3]:= '' ;
 Tokens[CmdType(139),1]:= ' '      ; Tokens[CmdType(139),2]:= ''      ; Tokens[CmdType(139),3]:= '' ;
 Tokens[CmdType(140),1]:= ' '      ; Tokens[CmdType(140),2]:= ''      ; Tokens[CmdType(140),3]:= '' ;
 Tokens[CmdType(141),1]:= ' '      ; Tokens[CmdType(141),2]:= ''      ; Tokens[CmdType(141),3]:= '' ;
 Tokens[CmdType(142),1]:= ' '      ; Tokens[CmdType(142),2]:= ''      ; Tokens[CmdType(142),3]:= '' ;
 Tokens[CmdType(143),1]:= ' '      ; Tokens[CmdType(143),2]:= ''      ; Tokens[CmdType(143),3]:= '' ;
 Tokens[CmdType(144),1]:= ' '      ; Tokens[CmdType(144),2]:= ''      ; Tokens[CmdType(144),3]:= '' ;
 Tokens[CmdType(145),1]:= ' '      ; Tokens[CmdType(145),2]:= ''      ; Tokens[CmdType(145),3]:= '' ;
 Tokens[CmdType(146),1]:= ' '      ; Tokens[CmdType(146),2]:= ''      ; Tokens[CmdType(146),3]:= '' ;
 Tokens[CmdType(147),1]:= ' '      ; Tokens[CmdType(147),2]:= ''      ; Tokens[CmdType(147),3]:= '' ;
 Tokens[CmdType(148),1]:= ' '      ; Tokens[CmdType(148),2]:= ''      ; Tokens[CmdType(148),3]:= '' ;
 Tokens[CmdType(149),1]:= ' '      ; Tokens[CmdType(149),2]:= ''      ; Tokens[CmdType(149),3]:= '' ;
 Tokens[CmdType(150),1]:= ' '      ; Tokens[CmdType(150),2]:= ''      ; Tokens[CmdType(150),3]:= '' ;
 Tokens[CmdType(151),1]:= ' '      ; Tokens[CmdType(151),2]:= ''      ; Tokens[CmdType(151),3]:= '' ;
 Tokens[CmdType(152),1]:= 'SAVE'   ; Tokens[CmdType(152),2]:= 'AS'    ; Tokens[CmdType(152),3]:= '' ;
 Tokens[CmdType(153),1]:= ' '      ; Tokens[CmdType(153),2]:= ''      ; Tokens[CmdType(153),3]:= '' ;
 Tokens[CmdType(154),1]:= 'PREV'   ; Tokens[CmdType(154),2]:= 'WINDOW'; Tokens[CmdType(154),3]:= '' ;
SpKey[00+1].name:= 'ESC' ;  SpKey[00+1].code:= #$1B#$1B#$1B;
SpKey[01+1].name:= 'F10' ;  SpKey[01+1].code:= #$D2#$DE#$EA;
SpKey[02+1].name:= 'F11' ;  SpKey[02+1].code:= #$D3#$DF#$EB;
SpKey[03+1].name:= 'F12' ;  SpKey[03+1].code:= #$D4#$E0#$EC;
SpKey[04+1].name:= 'F1'  ;  SpKey[04+1].code:= #$C9#$D5#$E1;
SpKey[05+1].name:= 'F2'  ;  SpKey[05+1].code:= #$CA#$D6#$E2;
SpKey[06+1].name:= 'F3'  ;  SpKey[06+1].code:= #$CB#$D7#$E3;
SpKey[07+1].name:= 'F4'  ;  SpKey[07+1].code:= #$CC#$D8#$E4;
SpKey[08+1].name:= 'F5'  ;  SpKey[08+1].code:= #$CD#$D9#$E5;
SpKey[09+1].name:= 'F6'  ;  SpKey[09+1].code:= #$CE#$DA#$E6;
SpKey[10+1].name:= 'F7'  ;  SpKey[10+1].code:= #$CF#$DB#$E7;
SpKey[11+1].name:= 'F8'  ;  SpKey[11+1].code:= #$D0#$DC#$E8;
SpKey[12+1].name:= 'F9'  ;  SpKey[12+1].code:= #$D1#$DD#$E9;
SpKey[13+1].name:= 'TAB' ;  SpKey[13+1].code:= #$ED#$EE#$ED;
SpKey[14+1].name:= 'BACKSP';SpKey[14+1].code:= #$7F#$7F#$EF;
SpKey[15+1].name:= 'ENTER'; SpKey[15+1].code:= #$C0#$C0#$F0;
SpKey[16+1].name:= 'LEFT' ; SpKey[16+1].code:= #$C1#$C5#$F1;
SpKey[17+1].name:= 'RIGHT'; SpKey[17+1].code:= #$C2#$C6#$F2;
SpKey[18+1].name:= 'DOWN' ; SpKey[18+1].code:= #$C3#$C7#$F3;
SpKey[19+1].name:= 'UP'   ; SpKey[19+1].code:= #$C4#$C8#$F4;
SpKey[20+1].name:= 'HOME' ; SpKey[20+1].code:= #$C5#$C5#$F5;
SpKey[21+1].name:= 'END'  ; SpKey[21+1].code:= #$C6#$C6#$F6;
SpKey[22+1].name:= 'PGDN' ; SpKey[22+1].code:= #$C7#$C7#$F7;
SpKey[23+1].name:= 'PGUP' ; SpKey[23+1].code:= #$C8#$C8#$F8;
SpKey[24+1].name:= 'DELETE';SpKey[24+1].code:= #$F9#$F9#$F9;
SpKey[25+1].name:= 'DEL'  ; SpKey[25+1].code:= #$F9#$F9#$F9;
SpKey[26+1].name:= 'INSERT';SpKey[26+1].code:= #$FA#$FA#$FA;
SpKey[27+1].name:= 'INS'  ; SpKey[27+1].code:= #$FA#$FA#$FA;
SpKey[28+1].name:= 'RUBOUT';SpKey[28+1].code:= #$7F#$7F#$EF;
SpKey[29+1].name:= 'RUB'  ; SpKey[29+1].code:= #$7F#$7F#$EF;
SpKey[30+1].name:= 'LAT'  ; SpKey[30+1].code:= #$FB#$FB#$FB;
SpKey[31+1].name:= 'CAPS' ; SpKey[31+1].code:= #$FC#$FC#$FC;
SpKey[32+1].name:= 'PAUSE'; SpKey[32+1].code:= #$FD#$FD#$FD;
SpKey[33+1].name:= 'BREAK'; SpKey[33+1].code:= #$FE#$FE#$FE;
SpKey[34+1].name:= 'SPACE'; SpKey[34+1].code:= #$20#$FD#$FE;
Delimiters:=  [ #39,'"'];
Separators:=  [ '{','['];
ODelimTbl[1]:= '{'; ODelimTbl[2]:= '}';
ODelimTbl[3]:= '['; ODelimTbl[4]:= ']';
Bool[true]:= 'Yes'; Bool[false]:= 'No ';
Equal := '=';
Shift := 'S';
Contr := 'C';
Space := ' ';
Lpar  := '[';
Rpar  := ']';
LBpar := '{';
UsrEndList:= 0;
end; {constinit}