;
; HJ12864-COG-5
;
; POUT0 - PIN_RS
; POUT1 - PIN_BLN
;

PIN_RS	equ	$01
PIN_BLN	equ	$02

	include ../DEVMAP.INC

	include ../ROM/BOOTMEM.INC

	include ../ROM/BOOTROM.INC

	org $100

	sei

	lds	#$fff

	ldx	#hello
;	int	F_PUTSTR
	jsr	F_UART_PUTS

	jsr	disp_init

	ldx	#font
	jsr	send_data

	jmp	F_RESET

send_byte proc
;	jsr	printhex
busy	ldab	SPI_STATUS
	bitb	#SPI_READY
	beq	busy
	staa	SPI_DATA+1
	rts
	endp

send_cmd proc
;	jsr	printhex
	pshb

	ldab	SPI_POUT
	orab	#PIN_RS
	stab	SPI_POUT

	ldab	SPI_CONFIG
	andb	#$FF^SPI_SS0
	stab	SPI_CONFIG

	ldab	#8
loop	pshb
	bsr	send_byte
	pulb
	decb
	bne	loop

busy	ldab	SPI_STATUS
	bitb	#SPI_READY
	beq	busy

	ldab	SPI_CONFIG
	orab	#SPI_SS0
	stab	SPI_CONFIG

	pulb
	rts
	endp

send_data proc
;	jsr	printhex
	psha
	pshb
	pshx

	ldab	SPI_POUT
	andb	#$FF^PIN_RS
	stab	SPI_POUT

	ldab	SPI_CONFIG
	andb	#$FF^SPI_SS0
	stab	SPI_CONFIG

	pshx
	ldab	#40
loop1	pshb
	ldaa	120,x
	bsr	send_byte
	inx
	pulb
	decb
	bne	loop1
	pulx

	pshx
	ldab	#40
loop2	pshb
	ldaa	80,x
	bsr	send_byte
	inx
	pulb
	decb
	bne	loop2
	pulx

	pshx
	ldab	#40
loop3	pshb
	ldaa	40,x
	bsr	send_byte
	inx
	pulb
	decb
	bne	loop3
	pulx

	pshx
	ldab	#40
loop4	pshb
	ldaa	0,x
	jsr	send_byte
	inx
	pulb
	decb
	bne	loop4
	pulx

busy	ldab	SPI_STATUS
	bitb	#SPI_READY
	beq	busy

	ldab	SPI_CONFIG
	orab	#SPI_SS0
	stab	SPI_CONFIG

	pulx
	pulb
	pula
	rts
	endp

delay	proc
	pshb
	psha
loop	ldab	#110
loop1	decb
	bne	loop1
	deca
	bne	loop
	pula
	pulb
	rts
	endp

disp_init proc
	ldaa	SPI_POUT
	anda	#$FF^PIN_BLN
	staa	SPI_POUT

	ldaa	#2
	staa	SPI_PRESCALER
	ldaa	SPI_CONFIG
	oraa	#(SPI_SSM | SPI_SS0)
	staa	SPI_CONFIG

	ldaa	#$68	; 01001100
	jsr	send_cmd

	rts
	endp

printhex proc
	pshx
	psha
	pshb
	jsr	F_UART_PUTHEX
	tba
	jsr	F_UART_PUTHEX
	ldx	#crlf
	jsr	F_UART_PUTS
	pulb
	pula
	pulx
	rts
crlf	db	10, 13, 0
	endp

hello	db	'HCMS test', 10, 13, 0

font	db	 $00, $00, $00, $00, $00	; ' '
	db	 $00, $00, $5F, $00, $00	; '!'
	db	 $00, $07, $00, $07, $00	; '"'
	db	 $14, $7F, $14, $7F, $14	; '#'
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	db	 $08, $1C, $2A, $08, $08	; ' '
