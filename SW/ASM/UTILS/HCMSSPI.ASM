;
; HJ12864-COG-5
;
; POUT0 - PIN_RS
; POUT1 - PIN_BLN
;

PIN_RS	equ	$01
PIN_BLN	equ	$02

	include ../../DEVMAP.INC
	include ../UNI/MEMORY.INC

		section 0
dispx		ds	1
dispy		ds	1
dispw		ds	1
disph		ds	1
font		ds	2
framebuf	ds	2
		ends

		org $100

		ldx	#hello
		int	$23

		ldx	#disptbl
		ldaa	#16
		staa	dispw,x
		ldaa	#2
		staa	disph,x
		clr	dispx,x
		clr	dispy,x

		jsr	disp_init

		ldaa	#$0c
		bsr	putchar

		ldx	#$FFCE
		bsr	putstring
		ldaa	#10
		bsr	putchar

readkey		int	$20
		int	$25
		bsr	putchar


		ldx	#disptbl
		ldx	framebuf,x
		jsr	send_data

		bra	readkey

		rts

putstring	proc
loop		ldaa	0,x
		beq	exit
		pshx
		bsr	putchar
		pulx
		inx
		bra	loop
exit		rts
		endp

putchar		proc
		sei
		ldx	#disptbl
		cmpa	#$0D
		bne	chkclr
		clr	dispx,x
		bra	exit
chkclr		cmpa	#$0C
		bne	checklf
		clr	dispx,x
		clr	dispy,x
		bra	clrscr
checklf		cmpa	#$0A
		beq	linefeed
		psha
		clrb
		ldaa	dispy,x
calcy		tsta
		beq	calcx
		addb	dispw,x
		deca
		bra	calcy
calcx		ldaa	#5
		mul
		addb	dispx,x
		addb	dispx,x
		addb	dispx,x
		addb	dispx,x
		addb	dispx,x
		addd	framebuf,x
		std	tmpx
		pula
		ldab	#5
		mul
		addd	font,x
		xgdx
		sts	tmps
		txs
		ldx	tmpx
		pula
		staa	0,x
		pula
		staa	1,x
		pula
		staa	2,x
		pula
		staa	3,x
		pula
		staa	4,x
		lds	tmps

		ldx	#disptbl
		ldaa	dispx,x
		inca
		cmpa	dispw,x
		bhs	exit
		staa	dispx,x
exit		cli
		rts
linefeed	clr	dispx,x
		ldaa	dispy,x
		inca
		cmpa	disph,x
		bhs	scroll
		staa	dispy,x
		bra	exit
scroll		ldaa	dispw,x
		ldab	#5
		mul
		pshb
		ldx	framebuf,x
scrol1		ldaa	80,x
		staa	0,x
		inx
		decb
		bne	scrol1
		pulb
		clra
scrol2		staa	0,x
		inx
		decb
		bne	scrol2
		bra	exit
clrscr		ldx	#disptbl
		ldaa	dispw,x
		ldab	disph,x
		mul
		ldaa	#5
		mul
		ldx	framebuf,x
		clra
clrscr1		staa	0,x
		inx
		decb
		bne	clrscr1
		bra	exit
		endp

send_byte proc
busy	ldab	SPI_STATUS
	bitb	#SPI_READY
	beq	busy
	staa	SPI_DATA+1
	rts
	endp

send_cmd proc
	pshb

	ldab	SPI_POUT
	orab	#PIN_RS
	stab	SPI_POUT

	ldab	SPI_CONFIG
	andb	#$FF^SPI_SS0
	stab	SPI_CONFIG

	ldab	#8
loop	pshb
	bsr	send_byte
	pulb
	decb
	bne	loop

busy	ldab	SPI_STATUS
	bitb	#SPI_READY
	beq	busy

	ldab	SPI_CONFIG
	orab	#SPI_SS0
	stab	SPI_CONFIG

	pulb
	rts
	endp

send_data proc
	psha
	pshb
	pshx

	ldab	SPI_POUT
	andb	#$FF^PIN_RS
	stab	SPI_POUT

	ldab	SPI_CONFIG
	andb	#$FF^SPI_SS0
	stab	SPI_CONFIG

	pshx
	ldab	#40
loop1	pshb
	ldaa	120,x
	bsr	send_byte
	inx
	pulb
	decb
	bne	loop1
	pulx

	pshx
	ldab	#40
loop2	pshb
	ldaa	80,x
	bsr	send_byte
	inx
	pulb
	decb
	bne	loop2
	pulx

	pshx
	ldab	#40
loop3	pshb
	ldaa	40,x
	bsr	send_byte
	inx
	pulb
	decb
	bne	loop3
	pulx

	pshx
	ldab	#40
loop4	pshb
	ldaa	0,x
	jsr	send_byte
	inx
	pulb
	decb
	bne	loop4
	pulx

busy	ldab	SPI_STATUS
	bitb	#SPI_READY
	beq	busy

	ldab	SPI_CONFIG
	orab	#SPI_SS0
	stab	SPI_CONFIG

	pulx
	pulb
	pula
	rts
	endp

delay	proc
	pshb
	psha
loop	ldab	#110
loop1	decb
	bne	loop1
	deca
	bne	loop
	pula
	pulb
	rts
	endp

disp_init proc
	ldaa	SPI_POUT
	anda	#$FF^PIN_BLN
	staa	SPI_POUT

	ldaa	#2
	staa	SPI_PRESCALER
	ldaa	SPI_CONFIG
	oraa	#(SPI_SSM | SPI_SS0)
	staa	SPI_CONFIG

	ldaa	#$68	; 01001100
	jsr	send_cmd

	rts
	endp

hello	db	'HCMS test', 10, 0

disptbl	db	0, 0	; W, W
	db	0, 0	; X, Y
	dw	font5x7
	dw	grfbuff

grfbuff	ds	32*5	; framebuffer

font5x7
	db	 $FF, $FF, $FF, $FF, $FF	; 00
	db	 $FF, $FF, $FF, $FF, $FF	; 01
	db	 $FF, $FF, $FF, $FF, $FF	; 02
	db	 $FF, $FF, $FF, $FF, $FF	; 03
	db	 $FF, $FF, $FF, $FF, $FF	; 04
	db	 $FF, $FF, $FF, $FF, $FF	; 05
	db	 $FF, $FF, $FF, $FF, $FF	; 06
	db	 $FF, $FF, $FF, $FF, $FF	; 07
	db	 $FF, $FF, $FF, $FF, $FF	; 08
	db	 $FF, $FF, $FF, $FF, $FF	; 09
	db	 $FF, $FF, $FF, $FF, $FF	; 0A
	db	 $FF, $FF, $FF, $FF, $FF	; 0B
	db	 $FF, $FF, $FF, $FF, $FF	; 0C
	db	 $FF, $FF, $FF, $FF, $FF	; 0D
	db	 $FF, $FF, $FF, $FF, $FF	; 0E
	db	 $FF, $FF, $FF, $FF, $FF	; 0F
	db	 $FF, $FF, $FF, $FF, $FF	; 10
	db	 $FF, $FF, $FF, $FF, $FF	; 11
	db	 $FF, $FF, $FF, $FF, $FF	; 12
	db	 $FF, $FF, $FF, $FF, $FF	; 13
	db	 $FF, $FF, $FF, $FF, $FF	; 14
	db	 $FF, $FF, $FF, $FF, $FF	; 15
	db	 $FF, $FF, $FF, $FF, $FF	; 16
	db	 $FF, $FF, $FF, $FF, $FF	; 17
	db	 $FF, $FF, $FF, $FF, $FF	; 18
	db	 $FF, $FF, $FF, $FF, $FF	; 19
	db	 $FF, $FF, $FF, $FF, $FF	; 1A
	db	 $FF, $FF, $FF, $FF, $FF	; 1B
	db	 $FF, $FF, $FF, $FF, $FF	; 1C
	db	 $FF, $FF, $FF, $FF, $FF	; 1D
	db	 $FF, $FF, $FF, $FF, $FF	; 1E
	db	 $FF, $FF, $FF, $FF, $FF	; 1F

	db	 $00, $00, $00, $00, $00	; ' '
	db	 $00, $00, $5F, $00, $00	; '!'
	db	 $00, $07, $00, $07, $00	; '"'
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	db	 $08, $1C, $2A, $08, $08	; ' '
	db	 $7C, $12, $11, $12, $7C	; 80
	db	 $7F, $49, $49, $49, $31	; 81
	db	 $7F, $49, $49, $49, $36	; 82
	db	 $7F, $01, $01, $01, $01	; 83
	db	 $60, $3F, $21, $3F, $60	; 84
	db	 $7F, $49, $49, $49, $41	; 85
	db	 $77, $08, $7F, $08, $77	; 86
	db	 $22, $41, $49, $49, $36	; 87
	db	 $7F, $10, $08, $04, $7F	; 88
	db	 $7E, $10, $09, $04, $7E	; 89
	db	 $7F, $08, $14, $22, $41	; 8A
	db	 $40, $3E, $01, $01, $7F	; 8B
	db	 $7F, $02, $0C, $02, $7F	; 8C
	db	 $7F, $08, $08, $08, $7F	; 8D
	db	 $3E, $41, $41, $41, $3E	; 8E
	db	 $7F, $01, $01, $01, $7F	; 8F
	db	 $7F, $09, $09, $09, $06	; 90
	db	 $3E, $41, $41, $41, $22	; 91
	db	 $01, $01, $7F, $01, $01	; 92
	db	 $07, $48, $48, $48, $3F	; 93
	db	 $0E, $11, $7F, $11, $0E	; 94
	db	 $63, $14, $08, $14, $63	; 95
	db	 $3F, $20, $20, $3F, $60	; 96
	db	 $07, $08, $08, $08, $7F	; 97
	db	 $7F, $40, $7E, $40, $7F	; 98
	db	 $3F, $20, $3F, $20, $7F	; 99
	db	 $01, $7F, $48, $48, $30	; 9A
	db	 $7F, $48, $30, $00, $7F	; 9B
	db	 $00, $7F, $48, $48, $30	; 9C
	db	 $22, $41, $49, $49, $3E	; 9D
	db	 $7F, $08, $3E, $41, $3E	; 9E
	db	 $46, $29, $19, $09, $7F	; 9F
	db	 $20, $54, $54, $54, $78	; A0
	db	 $3C, $4A, $4A, $4A, $31	; A1
	db	 $7C, $54, $54, $28, $00	; A2
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	db	 $FF, $FF, $FF, $FF, $FF	; FF
